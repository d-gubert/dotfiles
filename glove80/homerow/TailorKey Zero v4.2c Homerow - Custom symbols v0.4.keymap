/*
 * Copyright (c) 2020 The ZMK Contributors
 * Copyright (c) 2025 Innaworks Development Limited, trading as MoErgo
 *
 * SPDX-License-Identifier: MIT
 */


/* THIS FILE WAS GENERATED BY GLOVE80 LAYOUT EDITOR
 *
 * This file was generated automatically. You may or may not want to
 * edit it directly.
 */

#include <behaviors.dtsi>
/* Include all behavior includes needed */
#include <dt-bindings/zmk/outputs.h>
#include <dt-bindings/zmk/keys.h>
#include <dt-bindings/zmk/bt.h>
#include <dt-bindings/zmk/rgb.h>

/* On demand includes */
#include <dt-bindings/zmk/input_transform.h>
#include <dt-bindings/zmk/pointing.h>
#include <input/processors.dtsi>

/* Helper Macros, based on https://github.com/urob/zmk-helpers/ */

#pragma once

#define ZMK_HELPER_STRINGIFY(x) #x

// Preprocessor mechanism to overload macros, cf. https://stackoverflow.com/a/27051616/6114651
#define VARGS_(_10, _9, _8, _7, _6, _5, _4, _3, _2, _1, N, ...) N
#define VARGS(...) VARGS_(__VA_ARGS__, 10, 9, 8, 7, 6, 5, 4, 3, 2, 1, 0)
#define CONCAT_(a, b) a##b
#define CONCAT(a, b) CONCAT_(a, b)

#define ZMK_BEHAVIOR_CORE_tap_dance  \
    compatible = "zmk,behavior-tap-dance"; \
    #binding-cells = <0>

#define ZMK_BEHAVIOR(name, type, ...) \
    name: name { \
        ZMK_BEHAVIOR_CORE_ ## type; \
        __VA_ARGS__ \
    };

#define ZMK_TAP_DANCE(name, ...) \
    ZMK_BEHAVIOR(name, tap_dance, __VA_ARGS__)

#define ZMK_TD_LAYER(name, layer) \
    ZMK_TAP_DANCE(name, \
        tapping-term-ms = <200>; \
        bindings = <&mo layer>, <&to layer>; \
)

/* Environment and metadata defines */
#define KB_TYPE_GLOVE_80 1
#define KB_TYPE_GO_60    2

#define KB_TYPE          KB_TYPE_GLOVE_80
#define EDITOR_HOST_OS   'L'

/* Automatically generated layer name defines */
#define LAYER_Homerow_Mods 0
#define LAYER_Cursor 1
#define LAYER_Lower 2
#define LAYER_Mouse 3
#define LAYER_MouseSlow 4
#define LAYER_MouseFast 5
#define LAYER_MouseWarp 6
#define LAYER_Magic 7
#define LAYER___Symbol__ 8
#define LAYER___Lower__ 9

/* To deal with the situation where there is no Lower layer, to keep &lower happy */
#ifndef LAYER_Lower
#define LAYER_Lower 0
#endif

/* Custom Device-tree */


/* Input Listeners */
&mmv_input_listener {
    // LAYER_MouseSlow
    LAYER_MouseSlow {
        layers = <LAYER_MouseSlow>;
        input-processors = <&zip_xy_scaler 1 9>;
    };
    // LAYER_MouseFast
    LAYER_MouseFast {
        layers = <LAYER_MouseFast>;
        input-processors = <&zip_xy_scaler 3 1>;
    };
    // LAYER_MouseWarp
    LAYER_MouseWarp {
        layers = <LAYER_MouseWarp>;
        input-processors = <&zip_xy_scaler 12 1>;
    };
};

&msc_input_listener {
    // LAYER_MouseSlow
    LAYER_MouseSlow {
        layers = <LAYER_MouseSlow>;
        input-processors = <&zip_xy_scaler 1 9>;
    };
    // LAYER_MouseFast
    LAYER_MouseFast {
        layers = <LAYER_MouseFast>;
        input-processors = <&zip_xy_scaler 3 1>;
    };
    // LAYER_MouseWarp
    LAYER_MouseWarp {
        layers = <LAYER_MouseWarp>;
        input-processors = <&zip_xy_scaler 12 1>;
    };
};

/* System behavior and Macros */
/ {
    behaviors {
        ZMK_TD_LAYER(lower, LAYER_Lower)
    };
};

/ {
    macros {
        rgb_ug_status_macro: rgb_ug_status_macro {
            label = "RGB_UG_STATUS";
            compatible = "zmk,behavior-macro";
            #binding-cells = <0>;
            bindings
                = <&rgb_ug RGB_STATUS>;
        };
    };
};


/ {
#ifdef BT_DISC_CMD
    behaviors {
        bt_0: bt_0 {
            compatible = "zmk,behavior-tap-dance";
            label = "BT_0";
            #binding-cells = <0>;
            tapping-term-ms = <200>;
            bindings = <&bt_select_0>, <&bt BT_DISC 0>;
        };
        bt_1: bt_1 {
            compatible = "zmk,behavior-tap-dance";
            label = "BT_1";
            #binding-cells = <0>;
            tapping-term-ms = <200>;
            bindings = <&bt_select_1>, <&bt BT_DISC 1>;
        };
        bt_2: bt_2 {
            compatible = "zmk,behavior-tap-dance";
            label = "BT_2";
            #binding-cells = <0>;
            tapping-term-ms = <200>;
            bindings = <&bt_select_2>, <&bt BT_DISC 2>;
        };
        bt_3: bt_3 {
            compatible = "zmk,behavior-tap-dance";
            label = "BT_3";
            #binding-cells = <0>;
            tapping-term-ms = <200>;
            bindings = <&bt_select_3>, <&bt BT_DISC 3>;
        };
    };
    macros {
        bt_select_0: bt_select_0 {
            label = "BT_SELECT_0";
            compatible = "zmk,behavior-macro";
            #binding-cells = <0>;
            bindings
                = <&out OUT_BLE>,
                  <&bt BT_SEL 0>;
        };
        bt_select_1: bt_select_1 {
            label = "BT_SELECT_1";
            compatible = "zmk,behavior-macro";
            #binding-cells = <0>;
            bindings
                = <&out OUT_BLE>,
                  <&bt BT_SEL 1>;
        };
        bt_select_2: bt_select_2 {
            label = "BT_SELECT_2";
            compatible = "zmk,behavior-macro";
            #binding-cells = <0>;
            bindings
                = <&out OUT_BLE>,
                  <&bt BT_SEL 2>;
        };
        bt_select_3: bt_select_3 {
            label = "BT_SELECT_3";
            compatible = "zmk,behavior-macro";
            #binding-cells = <0>;
            bindings
                = <&out OUT_BLE>,
                  <&bt BT_SEL 3>;
        };
    };
#else
    macros {
        bt_0: bt_0 {
            label = "BT_0";
            compatible = "zmk,behavior-macro";
            #binding-cells = <0>;
            bindings
                = <&out OUT_BLE>,
                  <&bt BT_SEL 0>;
        };
        bt_1: bt_1 {
            label = "BT_1";
            compatible = "zmk,behavior-macro";
            #binding-cells = <0>;
            bindings
                = <&out OUT_BLE>,
                  <&bt BT_SEL 1>;
        };
        bt_2: bt_2 {
            label = "BT_2";
            compatible = "zmk,behavior-macro";
            #binding-cells = <0>;
            bindings
                = <&out OUT_BLE>,
                  <&bt BT_SEL 2>;
        };
        bt_3: bt_3 {
            label = "BT_3";
            compatible = "zmk,behavior-macro";
            #binding-cells = <0>;
            bindings
                = <&out OUT_BLE>,
                  <&bt BT_SEL 3>;
        };
    };
#endif
};

/ {
    behaviors {
        magic: magic {
            compatible = "zmk,behavior-hold-tap";
            label = "MAGIC_HOLD_TAP";
            #binding-cells = <2>;
            flavor = "tap-preferred";
            tapping-term-ms = <200>;
            bindings = <&mo>, <&rgb_ug_status_macro>;
        };
    };
};


/* Key positions */

#define POS_LH_C6R1 0
#define POS_LH_C5R1 1
#define POS_LH_C4R1 2
#define POS_LH_C3R1 3
#define POS_LH_C2R1 4
#define POS_RH_C2R1 5
#define POS_RH_C3R1 6
#define POS_RH_C4R1 7
#define POS_RH_C5R1 8
#define POS_RH_C6R1 9
#define POS_LH_C6R2 10
#define POS_LH_C5R2 11
#define POS_LH_C4R2 12
#define POS_LH_C3R2 13
#define POS_LH_C2R2 14
#define POS_LH_C1R2 15
#define POS_RH_C1R2 16
#define POS_RH_C2R2 17
#define POS_RH_C3R2 18
#define POS_RH_C4R2 19
#define POS_RH_C5R2 20
#define POS_RH_C6R2 21
#define POS_LH_C6R3 22
#define POS_LH_C5R3 23
#define POS_LH_C4R3 24
#define POS_LH_C3R3 25
#define POS_LH_C2R3 26
#define POS_LH_C1R3 27
#define POS_RH_C1R3 28
#define POS_RH_C2R3 29
#define POS_RH_C3R3 30
#define POS_RH_C4R3 31
#define POS_RH_C5R3 32
#define POS_RH_C6R3 33
#define POS_LH_C6R4 34
#define POS_LH_C5R4 35
#define POS_LH_C4R4 36
#define POS_LH_C3R4 37
#define POS_LH_C2R4 38
#define POS_LH_C1R4 39
#define POS_RH_C1R4 40
#define POS_RH_C2R4 41
#define POS_RH_C3R4 42
#define POS_RH_C4R4 43
#define POS_RH_C5R4 44
#define POS_RH_C6R4 45
#define POS_LH_C6R5 46
#define POS_LH_C5R5 47
#define POS_LH_C4R5 48
#define POS_LH_C3R5 49
#define POS_LH_C2R5 50
#define POS_LH_C1R5 51
#define POS_LH_T1 52
#define POS_LH_T2 53
#define POS_LH_T3 54
#define POS_RH_T3 55
#define POS_RH_T2 56
#define POS_RH_T1 57
#define POS_RH_C1R5 58
#define POS_RH_C2R5 59
#define POS_RH_C3R5 60
#define POS_RH_C4R5 61
#define POS_RH_C5R5 62
#define POS_RH_C6R5 63
#define POS_LH_C6R6 64
#define POS_LH_C5R6 65
#define POS_LH_C4R6 66
#define POS_LH_C3R6 67
#define POS_LH_C2R6 68
#define POS_LH_T4 69
#define POS_LH_T5 70
#define POS_LH_T6 71
#define POS_RH_T6 72
#define POS_RH_T5 73
#define POS_RH_T4 74
#define POS_RH_C2R6 75
#define POS_RH_C3R6 76
#define POS_RH_C4R6 77
#define POS_RH_C5R6 78
#define POS_RH_C6R6 79


/* Custom Defined Behaviors */
/ {

};

/* Generated input processors */


/* Automatically generated macro definitions */
/ {
    macros {

        // Cursor Layer - Extent Line (seq) - TailorKey
        cur_EXTEND_LINE_v1_TKZ: cur_EXTEND_LINE_v1_TKZ {
            label = "&CUR_EXTEND_LINE_V1_TKZ";
            compatible = "zmk,behavior-macro";
            #binding-cells = <0>;
            tap-ms = <1>;
            wait-ms = <1>;
            bindings = <&kp LS(END)>;
        };

        // Cursor Layer - Extend Word (seq) - TailorKey
        cur_EXTEND_WORD_v1_TKZ: cur_EXTEND_WORD_v1_TKZ {
            label = "&CUR_EXTEND_WORD_V1_TKZ";
            compatible = "zmk,behavior-macro";
            #binding-cells = <0>;
            tap-ms = <1>;
            wait-ms = <1>;
            bindings = <&kp LC(LS(RIGHT))>;
        };

        // Cursor Layer - Select Line (seq) - TailorKey
        cur_SELECT_LINE_v1_TKZ: cur_SELECT_LINE_v1_TKZ {
            label = "&CUR_SELECT_LINE_V1_TKZ";
            compatible = "zmk,behavior-macro";
            #binding-cells = <0>;
            tap-ms = <1>;
            wait-ms = <1>;
            bindings = <&kp HOME>
                , <&kp LS(END)>;
        };

        // Cursor Layer - Select None (seq) - TailorKey
        cur_SELECT_NONE_v1_TKZ: cur_SELECT_NONE_v1_TKZ {
            label = "&CUR_SELECT_NONE_V1_TKZ";
            compatible = "zmk,behavior-macro";
            #binding-cells = <0>;
            tap-ms = <1>;
            wait-ms = <1>;
            bindings = <&kp DOWN>
                , <&kp UP>
                , <&kp RIGHT>
                , <&kp LEFT>;
        };

        // Cursor Layer - Select Word (seq) - TailorKey
        cur_SELECT_WORD_v1_TKZ: cur_SELECT_WORD_v1_TKZ {
            label = "&CUR_SELECT_WORD_V1_TKZ";
            compatible = "zmk,behavior-macro";
            #binding-cells = <0>;
            tap-ms = <1>;
            wait-ms = <1>;
            bindings = <&kp LC(LEFT)>
                , <&kp LC(LS(RIGHT))>;
        };

        // mod_tab_switcher - TailorKey
        //
        //
        mod_tab_v2_TKZ: mod_tab_v2_TKZ {
            label = "&MOD_TAB_V2_TKZ";
            compatible = "zmk,behavior-macro-one-param";
            #binding-cells = <1>;
            tap-ms = <0>;
            wait-ms = <0>;
            bindings = <&macro_press>
                , <&macro_param_1to1>
                , <&kp MACRO_PLACEHOLDER>
                , <&macro_tap>
                , <&kp TAB>
                , <&macro_pause_for_release>
                , <&macro_release>
                , <&macro_param_1to1>
                , <&kp MACRO_PLACEHOLDER>;
        };

        // macro string1 sample - Magic Layer F1 - Text output sample macro 1 "¡Hola!" - TailorKey
        mstr1_v1_TKZ: mstr1_v1_TKZ {
            label = "&MSTR1_V1_TKZ";
            compatible = "zmk,behavior-macro";
            #binding-cells = <0>;
            bindings = <&macro_press>
                , <&kp RALT>
                , <&macro_tap>
                , <&kp KP_N0>
                , <&kp KP_N1>
                , <&kp KP_N6>
                , <&kp KP_N1>
                , <&macro_release>
                , <&kp RALT>
                , <&macro_press>
                , <&kp LSHFT>
                , <&macro_tap>
                , <&kp H>
                , <&macro_release>
                , <&kp LSHFT>
                , <&macro_tap>
                , <&kp O>
                , <&kp L>
                , <&kp A>
                , <&kp LS(N1)>
                , <&kp SPACE>
                , <&kp RET>;
        };

        // macro string2 sample - Magic Layer F2 - Text output sample macro 2 "grammar check: <paste>" - TailorKey
        mstr2_v1_TKZ: mstr2_v1_TKZ {
            label = "&MSTR2_V1_TKZ";
            compatible = "zmk,behavior-macro";
            #binding-cells = <0>;
            bindings = <&macro_tap>
                , <&kp G>
                , <&kp R>
                , <&kp A>
                , <&kp M>
                , <&kp M>
                , <&kp A>
                , <&kp R>
                , <&kp SPACE>
                , <&kp C>
                , <&kp H>
                , <&kp E>
                , <&kp C>
                , <&kp K>
                , <&kp LS(SEMI)>
                , <&kp LC(V)>
                , <&kp RET>;
        };

        // Better combo triggering for things like "{" - "Shift + ["
        Shift_Combos: Shift_Combos {
            label = "&SHIFT_COMBOS";
            compatible = "zmk,behavior-macro-one-param";
            #binding-cells = <1>;
            bindings = <&macro_press>
                , <&kp LSHFT>
                , <&macro_tap>
                , <&macro_param_1to1>
                , <&kp MACRO_PLACEHOLDER>
                , <&macro_release>
                , <&kp LSHFT>;
        };
    };
};

/* Automatically generated behavior definitions */
/ {
    behaviors {


        // Home-row mod, same as the kanata tap-hold: tap for the key, hold for the modifier
        HRM: HRM {
            compatible = "zmk,behavior-hold-tap";
            #binding-cells = <2>;
            tapping-term-ms = <200>;
            bindings = <&kp>, <&kp>;
            flavor = "tap-preferred";
            quick-tap-ms = <150>;
        };

        // space_layer_access - TailorKey
        space_v2_TKZ: space_v2_TKZ {
            compatible = "zmk,behavior-hold-tap";
            #binding-cells = <2>;
            tapping-term-ms = <200>;
            bindings = <&mo>, <&kp>;
            flavor = "tap-preferred";
            quick-tap-ms = <150>;
            retro-tap;
        };

        // thumb_layer_access - TailorKey
        thumb_v2_TKZ: thumb_v2_TKZ {
            compatible = "zmk,behavior-hold-tap";
            #binding-cells = <2>;
            tapping-term-ms = <200>;
            bindings = <&mo>, <&kp>;
            flavor = "balanced";
            quick-tap-ms = <300>;
        };
    };
};

/* Automatically generated combos definitions */
/ {
    combos {
        compatible = "zmk,combos";

        // capslock when pressing both T1's - TailorKey
        combo_capslock_v1_TKZ {
            timeout-ms = <50>;
            key-positions = <POS_LH_T1 POS_RH_T1>;
            bindings = <&kp CAPS>;
            layers = <LAYER_Homerow_Mods>;
        };

        // F11 on RH_C5 and RH_R1+R2 - TailorKey
        combo_F11_v1_TKZ {
            timeout-ms = <50>;
            key-positions = <POS_RH_C5R1 POS_RH_C5R2>;
            bindings = <&kp F11>;
            layers = <LAYER_Homerow_Mods>;
        };

        // F12 on RH_C6 and RH_R1+R2 - TailorKey
        combo_F12_v1_TKZ {
            timeout-ms = <50>;
            key-positions = <POS_RH_C6R1 POS_RH_C6R2>;
            bindings = <&kp F12>;
            layers = <LAYER_Homerow_Mods>;
        };

        // sticky "AltGr" left - TailorKey
        combo_sticky_AltGr_left_v1_TKZ {
            timeout-ms = <50>;
            key-positions = <POS_LH_T5 POS_LH_T2>;
            bindings = <&sk RALT>;
            layers = <LAYER_Homerow_Mods>;
        };

        // sticky "AltGr" right - TailorKey
        combo_sticky_AltGr_right_v1_TKZ {
            timeout-ms = <50>;
            key-positions = <POS_RH_T2 POS_RH_T5>;
            bindings = <&sk RALT>;
            layers = <LAYER_Homerow_Mods>;
        };

        // sticky "hyper" modifiers (Win + Alt + Ctrl + Shift) - TailorKey
        combo_sticky_hyp_rght_v1_TKZ {
            timeout-ms = <50>;
            key-positions = <POS_RH_T4 POS_RH_T1>;
            bindings = <&sk LG(LA(LC(LSHFT)))>;
            layers = <LAYER_Homerow_Mods>;
        };

        // sticky "meh" modifiers (Alt + Ctrl + Shift) - TailorKey
        combo_sticky_meh_rght_v1_TKZ {
            timeout-ms = <50>;
            key-positions = <POS_RH_T5 POS_RH_T4>;
            bindings = <&sk LA(LC(LSHFT))>;
            layers = <LAYER_Homerow_Mods>;
        };
    };
};

/* Automatically generated keymap */
/ {
    keymap {
        compatible = "zmk,keymap";


        layer_Homerow_Mods {
            bindings = <
               &kp F1                          &kp F2                         &kp F3                           &kp F4                           &kp F5                                                                                                                                                                                 &kp F6                            &kp F7                          &kp F8                              &kp F9    &kp F10
            &kp EQUAL                          &kp N1                         &kp N2                           &kp N3                           &kp N4  &kp N5                                                                                                                                       &kp N6                            &kp N7                            &kp N8                          &kp N9                              &kp N0  &kp MINUS
              &kp TAB                           &kp Q                          &kp W                            &kp E                            &kp R   &kp T                                                                                                                                        &kp Y                             &kp U                             &kp I                           &kp O                               &kp P   &kp BSLH
              &kp ESC                     &HRM LGUI A                    &HRM LALT S                     &HRM LCTRL D                     &HRM LSHFT F   &kp G                                                                                                                                        &kp H                      &HRM RSHFT J                      &HRM RCTRL K                     &HRM LALT L                      &HRM RGUI SEMI    &kp SQT
            &kp GRAVE                           &kp Z                          &kp X                            &kp C                            &kp V   &kp B                        &kp LSHFT  &kp LCTRL   &kp DEL  &kp LGUI                      &kp RCTRL                             &kp RSHFT   &kp N                             &kp M                         &kp COMMA                         &kp DOT                            &kp FSLH  &kp PG_UP
 &magic LAYER_Magic 0                        &kp HOME                        &kp END                         &kp LEFT                        &kp RIGHT          &thumb_v2_TKZ LAYER_Cursor BSPC     &lower  &kp LALT  &kp RALT  &thumb_v2_TKZ LAYER_Mouse RET  &space_v2_TKZ LAYER___Symbol__ SPACE                                    &kp UP                          &kp DOWN                        &kp LBKT                            &kp RBKT  &kp PG_DN
            >;
        };

        layer_Cursor {
            bindings = <
     &none          &none                    &none                    &none      &none                                                                                                                                                                   &none          &none      &none      &none      &none
     &none      &kp LC(X)                    &none                    &none      &none        &none                                                                                                                                           &none      &none          &none      &none    &kp RET      &none
     &none      &kp LC(C)                 &kp BSPC                  &kp DEL    &kp RET      &kp ESC                                                                                                                                         &kp ESC    &kp RET       &kp BSPC    &kp DEL    &kp ESC      &none
 &sk LSHFT       &kp LGUI                 &kp LALT                &kp LCTRL  &kp LSHFT      &kp TAB                                                                                                                                         &kp TAB   &kp LEFT         &kp UP   &kp DOWN  &kp RIGHT  &sk RSHFT
 &kp LC(L)      &kp LC(A)  &cur_SELECT_LINE_v1_TKZ  &cur_SELECT_WORD_v1_TKZ  &kp LC(Y)  &kp LS(TAB)  &mod_tab_v2_TKZ LALT   &mod_tab_v2_TKZ LGUI  &kp PSCRN  &cur_SELECT_NONE_v1_TKZ  &cur_EXTEND_LINE_v1_TKZ  &cur_EXTEND_WORD_v1_TKZ  &kp LS(TAB)   &kp HOME      &kp PG_UP  &kp PG_DN    &kp END  &kp LC(L)
 &kp LC(K)  &kp LC(LS(G))  &cur_EXTEND_LINE_v1_TKZ  &cur_EXTEND_WORD_v1_TKZ  &kp LC(G)                              &none  &mod_tab_v2_TKZ LCTRL  &kp LG(D)                &kp LC(A)  &cur_SELECT_LINE_v1_TKZ  &cur_SELECT_WORD_v1_TKZ               &kp LC(F)  &kp LC(LS(G))  &kp LC(G)  &kp LC(H)  &kp LC(K)
            >;
        };

        layer_Lower {
            bindings = <
         &kp C_VOL_DN  &kp C_VOL_UP  &kp C_PREV    &kp C_PP  &kp C_NEXT                                                                                                         &kp C_MUTE      &kp C_BRI_UP   &kp C_BRI_DN   &none   &none
               &trans    &kp LG(N1)  &kp LG(N2)  &kp LG(N3)  &kp LG(N4)  &kp LG(N5)                                                                                 &kp LG(N6)  &kp LG(N7)  &kp LG(N8)     &kp LG(N9)    &kp LG(N0)   &none
               &trans     &kp LG(Q)   &kp LG(W)   &kp F11      &kp F12      &kp INS                                                                                  &kp GRAVE   &kp KP_N1   &kp KP_N2      &kp KP_N3      &kp RBKT   &none
               &trans     &kp LC(O)    &kp HOME     &kp ESC     &kp TAB     &kp RET                                                                              &kp LS(GRAVE)   &kp KP_N4   &kp KP_N5      &kp KP_N6  &kp LS(LBKT)   &none
               &trans         &none     &kp END     &kp LG(C)   &kp LG(V)  &kp SPACE     &trans                  &trans  &trans  &trans  &kp PG_DN     &kp PG_UP        &kp SQT   &kp KP_N7   &kp KP_N8      &kp KP_N9  &kp LS(RBKT)  &trans
 &magic LAYER_Magic 0       &kp END   &kp LC(Y)    &kp DOWN      &kp UP              &kp K_APP  &to LAYER_Homerow_Mods  &trans  &trans     &trans  &kp LC(LBKT)                 &kp LS(N6)   &kp KP_N0  &kp RA(COMMA)  &kp LS(BSLH)  &trans
            >;
        };

        layer_Mouse {
            bindings = <
 &trans          &trans               &trans               &trans               &trans                                                                                             &trans               &trans               &trans           &trans  &trans
 &trans          &trans               &trans               &trans               &trans     &trans                                                             &trans            &sk LSHFT            &sk LCTRL             &sk LALT         &sk LGUI  &trans
 &trans          &trans       &msc SCRL_LEFT         &mmv MOVE_UP      &msc SCRL_RIGHT  &kp LC(X)                                                          &kp LC(X)            &mkp LCLK            &mkp RCLK            &mkp MCLK         &mkp MB4  &trans
 &trans    &msc SCRL_UP       &mmv MOVE_LEFT       &mmv MOVE_DOWN      &mmv MOVE_RIGHT  &kp LC(C)                                                          &kp LC(C)  &mo LAYER_MouseFast  &mo LAYER_MouseWarp  &mo LAYER_MouseSlow         &mkp MB5  &trans
 &trans  &msc SCRL_DOWN  &mo LAYER_MouseSlow  &mo LAYER_MouseWarp  &mo LAYER_MouseFast  &kp LC(V)  &mkp MCLK  &kp K_APP  &mkp MB5  &trans  &trans  &trans  &kp LC(V)       &mmv MOVE_LEFT         &mmv MOVE_UP       &mmv MOVE_DOWN  &mmv MOVE_RIGHT  &trans
 &trans          &trans               &trans               &trans               &trans             &mkp LCLK  &mkp RCLK  &mkp MB4  &trans  &trans  &trans                  &msc SCRL_LEFT         &msc SCRL_UP       &msc SCRL_DOWN  &msc SCRL_RIGHT  &trans
            >;
        };

        layer_MouseSlow {
            bindings = <
 &trans  &trans  &trans  &trans  &trans                                                                  &trans  &trans  &trans  &trans  &trans
 &trans  &trans  &trans  &trans  &trans  &trans                                                  &trans  &trans  &trans  &trans  &trans  &trans
 &trans  &trans  &trans  &trans  &trans  &trans                                                  &trans  &trans  &trans  &trans  &trans  &trans
 &trans  &trans  &trans  &trans  &trans  &trans                                                  &trans  &trans  &trans  &trans  &trans  &trans
 &trans  &trans  &trans  &trans  &trans  &trans  &trans  &trans  &trans  &trans  &trans  &trans  &trans  &trans  &trans  &trans  &trans  &trans
 &trans  &trans  &trans  &trans  &trans          &trans  &trans  &trans  &trans  &trans  &trans          &trans  &trans  &trans  &trans  &trans
            >;
        };

        layer_MouseFast {
            bindings = <
 &trans  &trans  &trans  &trans  &trans                                                                  &trans  &trans  &trans  &trans  &trans
 &trans  &trans  &trans  &trans  &trans  &trans                                                  &trans  &trans  &trans  &trans  &trans  &trans
 &trans  &trans  &trans  &trans  &trans  &trans                                                  &trans  &trans  &trans  &trans  &trans  &trans
 &trans  &trans  &trans  &trans  &trans  &trans                                                  &trans  &trans  &trans  &trans  &trans  &trans
 &trans  &trans  &trans  &trans  &trans  &trans  &trans  &trans  &trans  &trans  &trans  &trans  &trans  &trans  &trans  &trans  &trans  &trans
 &trans  &trans  &trans  &trans  &trans          &trans  &trans  &trans  &trans  &trans  &trans          &trans  &trans  &trans  &trans  &trans
            >;
        };

        layer_MouseWarp {
            bindings = <
 &trans  &trans  &trans  &trans  &trans                                                                  &trans  &trans  &trans  &trans  &trans
 &trans  &trans  &trans  &trans  &trans  &trans                                                  &trans  &trans  &trans  &trans  &trans  &trans
 &trans  &trans  &trans  &trans  &trans  &trans                                                  &trans  &trans  &trans  &trans  &trans  &trans
 &trans  &trans  &trans  &trans  &trans  &trans                                                  &trans  &trans  &trans  &trans  &trans  &trans
 &trans  &trans  &trans  &trans  &trans  &trans  &trans  &trans  &trans  &trans  &trans  &trans  &trans  &trans  &trans  &trans  &trans  &trans
 &trans  &trans  &trans  &trans  &trans          &trans  &trans  &trans  &trans  &trans  &trans          &trans  &trans  &trans  &trans  &trans
            >;
        };

        layer_Magic {
            bindings = <
          &mstr1_v1_TKZ    &mstr2_v1_TKZ             &none            &none            &none                                                                                  &none   &none   &none  &bt BT_CLR  &bt BT_CLR_ALL
 &to LAYER_Homerow_Mods            &none             &none            &none            &none            &none                                                         &none   &none   &none   &none       &none           &none
                  &none  &rgb_ug RGB_SPI   &rgb_ug RGB_SAI  &rgb_ug RGB_HUI  &rgb_ug RGB_BRI  &rgb_ug RGB_TOG                                                         &none   &none   &none   &none       &none           &none
            &bootloader  &rgb_ug RGB_SPD   &rgb_ug RGB_SAD  &rgb_ug RGB_HUD  &rgb_ug RGB_BRD  &rgb_ug RGB_EFF                                                         &none   &none   &none   &none       &none     &bootloader
             &sys_reset            &none             &none            &none            &none            &none   &bt_2   &bt_3         &none   &none   &none   &none   &none   &none   &none   &none       &none      &sys_reset
                  &none            &none             &none            &none            &none                    &bt_0   &bt_1  &out OUT_USB   &none   &none   &none           &none   &none   &none       &none           &none
            >;
        };

        layer___Symbol__ {
            bindings = <
         &none              &none               &none               &none            &none                                                                                                 &none        &none          &none       &none   &none
         &none            &kp DOT    &Shift_Combos N9          &kp LS(N0)     &kp RA(FSLH)     &kp RA(N1)                                                                    &none     &sk RSHFT      &kp RET       &sk RALT    &sk RGUI   &none
     &kp COMMA           &kp LBKT  &Shift_Combos LBKT  &Shift_Combos RBKT         &kp RBKT     &kp LS(N1)                                                               &kp LS(N7)  &kp LS(FSLH)     &kp BSPC        &kp DEL     &kp INS   &none
     &sk RCTRL     &kp LS(RA(N6))           &kp EQUAL       &kp LS(MINUS)         &kp FSLH   &kp LS(BSLH)                                                               &kp LS(N4)  &kp LS(SEMI)   &kp LS(N2)  &kp RA(COMMA)  &kp LS(N3)   &none
 &kp LS(GRAVE)           &kp LEFT       &kp LS(EQUAL)           &kp MINUS         &kp BSLH  &kp LS(COMMA)      &kp UP     &kp DOT    &kp DOWN   &none   &none   &none  &kp LS(DOT)       &kp TAB  &kp LS(TAB)        &kp ESC   &kp RIGHT   &none
     &kp GRAVE  &kp LS(RA(GRAVE))       &kp RA(GRAVE)         &kp RA(SQT)  &kp LS(RA(SQT))                 &kp LS(N5)  &kp LS(N8)  &kp LS(N4)   &none   &none   &none                   &kp HOME    &kp PG_UP      &kp PG_DN     &kp END   &none
            >;
        };

        layer___Lower__ {
            bindings = <
         &kp C_BRI_DN  &kp C_BRI_UP      &kp C_PREV      &kp C_NEXT         &kp C_PP                                                                                         &kp C_MUTE  &kp C_VOL_DN  &kp C_VOL_UP            &none  &kp PAUSE_BREAK
               &trans         &none           &none           &none            &none   &kp HOME                                                                  &kp LS(N9)  &kp KP_NUM     &kp EQUAL  &kp KP_SLASH  &kp KP_MULTIPLY  &kp PRINTSCREEN
               &trans         &none           &none    &kp UP_ARROW            &none    &kp END                                                                  &kp LS(N0)   &kp KP_N7     &kp KP_N8     &kp KP_N9     &kp KP_MINUS   &kp SCROLLLOCK
               &trans         &none  &kp LEFT_ARROW  &kp DOWN_ARROW  &kp RIGHT_ARROW  &kp PG_UP                                                                  &kp LS(N5)   &kp KP_N4     &kp KP_N5     &kp KP_N6      &kp KP_PLUS            &none
               &trans     &kp K_APP           &none         &kp F11          &kp F12  &kp PG_DN  &trans  &trans  &to LAYER_Homerow_Mods  &trans  &trans  &trans   &kp COMMA   &kp KP_N1     &kp KP_N2     &kp KP_N3     &kp KP_ENTER           &trans
 &magic LAYER_Magic 0      &kp CAPS         &kp INS         &kp F11          &kp F12             &trans  &trans                  &trans  &trans  &trans  &trans               &kp KP_N0     &kp KP_N0    &kp KP_DOT     &kp KP_ENTER           &trans
            >;
        };

    };
};
